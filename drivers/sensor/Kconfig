## drivers/sensor/Kconfig
```kconfig
# Copyright (c) 2023 Golioth, Inc.
# SPDX-License-Identifier: Apache-2.0

if SENSOR

rsource "ina260/Kconfig"

endif # SENSOR
```

## drivers/sensor/ina260/Kconfig
```kconfig
# Copyright (c) 2023 Golioth, Inc.
# SPDX-License-Identifier: Apache-2.0

config INA260
	bool "INA260 Current and Power Monitor"
	default y
	depends on DT_HAS_TI_INA260_ENABLED
	select I2C
	help
	  Enable driver for the INA260 Current and Power Monitor.

config INA260_FAKE
	bool "Use FFF to simulate communication with INA260 sensor"
	default n
	depends on INA260
	select TEST
	help
	  Replaces the read register operation with a function that
	  returns static data readings

if INA260_FAKE
config TEST_LOGGING_DEFAULTS
	default n
endif
```
